#define FONT_BIG u8g2_font_inr46_mn
#define FONT_SMALL u8g2_font_5x8_tf
#define FONT_MEDIUM u8g2_font_7x14_tf

static unsigned char speaker_bits[] U8X8_PROGMEM = {
  0x00, 0x00, 0x00, 0x00, 0x00, 0x00, 0x00, 0x00, 0x00, 0x00, 0x00, 0x00,
  0x00, 0xE0, 0x00, 0x00, 0x00, 0xF0, 0x00, 0x00, 0x00, 0x58, 0x00, 0x00,
  0x00, 0xCE, 0x00, 0x00, 0x00, 0x43, 0x60, 0x00, 0xFC, 0x41, 0x60, 0x00,
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  0x00, 0x00, 0x00, 0x00
};

static unsigned char muted_bits[] U8X8_PROGMEM = {
  0x00, 0x00, 0x00, 0x00, 0x00, 0x00, 0x00, 0x00, 0x00, 0x00, 0x00, 0x00,
  0x10, 0xE0, 0x00, 0x00, 0x30, 0xF0, 0x00, 0x00, 0x60, 0x58, 0x00, 0x00,
  0xC0, 0xC8, 0x00, 0x00, 0x80, 0x41, 0x60, 0x00, 0xFC, 0x43, 0x60, 0x00,
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  0x00, 0x00, 0x00, 0x00
};

static unsigned char wifi_bits[] = {
  0x00, 0x00, 0x00, 0x00, 0x00, 0x00, 0xF0, 0x0F, 0x1C, 0x1C, 0xC6, 0x31,
  0xF2, 0x07, 0x18, 0x0C, 0xC0, 0x01, 0xE0, 0x03, 0x00, 0x00, 0x80, 0x00,
  0x80, 0x00, 0x00, 0x00, 0x00, 0x00,
};

static unsigned char no_wifi_bits[] = {
  0x00, 0x00, 0x00, 0x00, 0x0C, 0x01, 0xD8, 0x07, 0x3C, 0x1C, 0x66, 0x30,
  0x70, 0x07, 0xD8, 0x0C, 0xC0, 0x03, 0xE0, 0x03, 0x00, 0x06, 0x80, 0x0C,
  0x00, 0x18, 0x00, 0x00, 0x00, 0x00,
};

U8G2_ST7920_128X64_F_SW_SPI u8g2(U8G2_R0, /* clock=*/ 14, /* data=*/ 13, /* CS=*/ 15, /* reset=*/ 26); // Feather HUZZAH ESP8266, E=clock=14, RW=data=13, RS=CS

String tempString = "0";
String limitString = "ALARME: 0°C";

char tempBuf[3];
int tempBufLen = 3;
char tempLimiteBuf[25];
int tempLimiteBufLen = 25;

int tempStrX = 45;
int tempLimiteStrX = 39;

bool drawToggle = true;
uint32_t lastDrawToggle = millis();

void lcd_setup(void) {
  u8g2.begin();
}

void lcd_draw(void) {
  u8g2.clearBuffer();

  u8g2.setDrawColor(1);
  u8g2.setFont(FONT_BIG);

  memset(tempBuf, 0, 3);
  if (safe_subtraction(millis() / 1000, lastComm) < 15 && hasCommOnce) {
    u8g2.drawXBM(3, 50, 15, 15, wifi_bits);

    tempString = String(temperatura);
    tempBufLen = tempString.length();
    tempString.toCharArray(tempBuf, 3);
    tempStrX = 64 - (38 * tempBufLen / 2);
    u8g2.drawStr(tempStrX, 48, tempBuf);
  } else {
    u8g2.drawXBM(3, 50, 15, 15, no_wifi_bits);

    if (drawToggle) {
      tempString = String(temperatura);
      tempBufLen = tempString.length();
      tempString.toCharArray(tempBuf, 3);
      tempStrX = 64 - (38 * tempBufLen / 2);
      u8g2.drawStr(tempStrX, 48, tempBuf);
    }

    if (safe_subtraction(millis(), lastDrawToggle) > 1000) {
      drawToggle = !drawToggle;
      lastDrawToggle = millis();
    }
  }

  u8g2.setDrawColor(1);
  u8g2.setFont(FONT_MEDIUM);
  u8g2.drawUTF8(107, 15, "°C");

  u8g2.setDrawColor(1);
  u8g2.drawBox(23, 52, 81, 12);

  u8g2.setDrawColor(0);
  u8g2.setFont(FONT_SMALL);

  memset(tempLimiteBuf, 0, 25);
  limitString = "ALARME: " + String(tempLimite) + "°C";
  tempLimiteBufLen = limitString.length();
  limitString.toCharArray(tempLimiteBuf, 25);
  tempLimiteStrX = 64 - (5 * tempLimiteBufLen / 2);
  u8g2.drawUTF8(tempLimiteStrX, 61, tempLimiteBuf);

  u8g2.setDrawColor(1);
  u8g2.setBitmapMode(0);
  if (temperatura > tempLimite) {
    if (isAware) {
      u8g2.drawXBM(1, 0, 25, 25, muted_bits);
    } else {
      u8g2.drawXBM(1, 0, 25, 25, speaker_bits);
    }
  }

  u8g2.sendBuffer();
}
